## Kconfig
```kconfig
#
# $ Copyright Open Broadcom $
#
#
# <<Broadcom-WL-IPTag/Open:>>
#

config BCMDHD
	tristate "Broadcom/Cypress/IFX FullMAC wireless cards support"
	help
	  This module adds support for wireless adapters based on
	  Broadcom/Cypress/IFX FullMAC chipset.

config BCMDHD_ROCKCHIP_PLATFORM
	bool "Rockchip platform support"
	depends on BCMDHD
	default y

config HAVE_IMX8_SOC
	bool "Imx platform support"
	depends on BCMDHD
	default n

config CYW43438_SDIO
	bool "CYW43438_SDIO support"
	depends on BCMDHD
	default n

config BCM43456_SDIO
	bool "BCM43456_SDIO support"
	depends on BCMDHD
	default n

config CYW43455_SDIO
	bool "CYW43455_SDIO support"
	depends on BCMDHD
	default n

config CYW4354_SDIO
	bool "CYW4354_SDIO support"
	depends on BCMDHD
	default n

config CYW4373_SDIO
	bool "CYW4373_SDIO support"
	depends on BCMDHD
	default n

config CYW43012_SDIO
	bool "CYW43012_SDIO support"
	depends on BCMDHD
	default n

config CYW54591_SDIO
	bool "CYW54591_SDIO support"
	depends on BCMDHD
	default n

config CYW54591_PCIE
	bool "CYW54591_PCIE support"
	depends on BCMDHD
	default n

config CYW5557X_SDIO
	bool "CYW5557X_SDIO support"
	depends on BCMDHD
	default n

config CYW5557X_PCIE
	bool "CYW5557X_PCIE support"
	depends on BCMDHD
	default n

config WL_AP_IF
	bool "Create additional AP interface during intialization"
	depends on BCMDHD
	default n

config BCMDHD_FIRMWARE_MAPPING
	bool "Use firmware mapping table to autodiscovery firmware, nvram, clm_blob"
	depends on BCMDHD
	default y
```
